## conf/layer.conf
```bitbake
# We have a conf and classes directory, add to BBPATH
BBPATH .= ":${LAYERDIR}"

# We have recipes-* directories, add to BBFILES
BBFILES += "${LAYERDIR}/recipes-*/*/*.bb \
            ${LAYERDIR}/recipes-*/*/*.bbappend"

BBFILE_COLLECTIONS += "meta-agl-demo-cluster"
BBFILE_PATTERN_meta-agl-demo-cluster = "^${LAYERDIR}/"
BBFILE_PRIORITY_meta-agl-demo-cluster = "70"

LAYERDEPENDS_meta-agl-demo-cluster = "core"
LAYERSERIES_COMPAT_meta-agl-demo-cluster = "dunfell"
```
